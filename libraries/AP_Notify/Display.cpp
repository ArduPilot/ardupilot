/*
   This program is free software: you can redistribute it and/or modify
   it under the terms of the GNU General Public License as published by
   the Free Software Foundation, either version 3 of the License, or
   (at your option) any later version.

   This program is distributed in the hope that it will be useful,
   but WITHOUT ANY WARRANTY; without even the implied warranty of
   MERCHANTABILITY or FITNESS FOR A PARTICULAR PURPOSE.  See the
   GNU General Public License for more details.

   You should have received a copy of the GNU General Public License
   along with this program.  If not, see <http://www.gnu.org/licenses/>.
 */

/* Notify display driver for 128 x 64 pixel displays */
#include "Display.h"
#include "Display_SH1106_I2C.h"
#include "Display_SSD1306_I2C.h"
#include "Display_SITL.h"

#include "AP_Notify.h"

#include <stdio.h>
#include <AP_GPS/AP_GPS.h>
#include <AP_BattMonitor/AP_BattMonitor.h>

#include <utility>

extern const AP_HAL::HAL& hal;

// Bit Map
// Rotate right 90 degrees
// Ex: 0x7C, 0x12, 0x11, 0x12, 0x7C,  // 'A'
// 0XXXXX00
// 000X00X0
// 000X000X
// 000X00X0
// 0XXXXX00
static const uint8_t _font[] = {
#ifdef AP_NOTIFY_DISPLAY_USE_EMOJI
    // 0x Group
    0x00, 0x00, 0x00, 0x00, 0x00,  // 00
    0x3E, 0x5B, 0x4F, 0x5B, 0x3E,  // 01
    0x3E, 0x6B, 0x4F, 0x6B, 0x3E,  // 02
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    0x5A, 0x3C, 0xE7, 0x3C, 0x5A,  // 0F
    // 1x Group
    0x7F, 0x3E, 0x1C, 0x1C, 0x08,  // 10
    0x08, 0x1C, 0x1C, 0x3E, 0x7F,  // 11
    0x14, 0x22, 0x7F, 0x22, 0x14,  // 12
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    0x06, 0x0E, 0x3E, 0x0E, 0x06,  // 1F
#endif
    // 2x Group
    0x00, 0x00, 0x00, 0x00, 0x00,  // ' '
    0x00, 0x00, 0x5F, 0x00, 0x00,  // '!'
    0x00, 0x07, 0x00, 0x07, 0x00,  // '"'
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    0x20, 0x10, 0x08, 0x04, 0x02,  // '/'
    // 3x Group
    0x3E, 0x51, 0x49, 0x45, 0x3E,  // '0'
    0x00, 0x42, 0x7F, 0x40, 0x00,  // '1'
    0x72, 0x49, 0x49, 0x49, 0x46,  // '2'
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    0x02, 0x01, 0x59, 0x09, 0x06,  // '?'
    // 4x Group
    0x3E, 0x41, 0x5D, 0x59, 0x4E,  // '@'
    0x7C, 0x12, 0x11, 0x12, 0x7C,  // 'A'
    0x7F, 0x49, 0x49, 0x49, 0x36,  // 'B'
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    0x3E, 0x41, 0x41, 0x41, 0x3E,  // 'O'
    // 5x Group
    0x7F, 0x09, 0x09, 0x09, 0x06,  // 'P'
    0x3E, 0x41, 0x51, 0x21, 0x5E,  // 'Q'
    0x7F, 0x09, 0x19, 0x29, 0x46,  // 'R'
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    0x40, 0x40, 0x40, 0x40, 0x40,  // '_'
    // 6x Group
    0x00, 0x03, 0x07, 0x08, 0x00,  // '`'
    0x20, 0x54, 0x54, 0x78, 0x40,  // 'a'
    0x7F, 0x28, 0x44, 0x44, 0x38,  // 'b'
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    0x38, 0x44, 0x44, 0x44, 0x38,  // 'o'
    // 7x Group
    0xFC, 0x18, 0x24, 0x24, 0x18,  // 'p'
    0x18, 0x24, 0x24, 0x18, 0xFC,  // 'q'
    0x7C, 0x08, 0x04, 0x04, 0x08,  // 'r'
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    0x02, 0x01, 0x02, 0x04, 0x02,  // '~'
#ifdef AP_NOTIFY_DISPLAY_USE_EMOJI
    0x3C, 0x26, 0x23, 0x26, 0x3C,  // 7F
    // 8x Group
    0x1E, 0xA1, 0xA1, 0x61, 0x12,  // 80
    0x3A, 0x40, 0x40, 0x20, 0x7A,  // 81
    0x38, 0x54, 0x54, 0x55, 0x59,  // 82
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    0xF0, 0x28, 0x25, 0x28, 0xF0,  // 8F
    // 9x Group
    0x7C, 0x54, 0x55, 0x45, 0x00,  // 90
    0x20, 0x54, 0x54, 0x7C, 0x54,  // 91
    0x7C, 0x0A, 0x09, 0x7F, 0x49,  // 92
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    0xC0, 0x88, 0x7E, 0x09, 0x03,  // 9F
    // Ax Group
    0x20, 0x54, 0x54, 0x79, 0x41,  // A0
    0x00, 0x00, 0x44, 0x7D, 0x41,  // A1
    0x30, 0x48, 0x48, 0x4A, 0x32,  // A2
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    0x22, 0x14, 0x2A, 0x14, 0x08,  // AF
    // Bx Group
    0x55, 0x00, 0x55, 0x00, 0x55,  // B0
    0xAA, 0x55, 0xAA, 0x55, 0xAA,  // B1
    0xFF, 0x55, 0xFF, 0x55, 0xFF,  // B2
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    0x10, 0x10, 0x10, 0xF0, 0x00,  // BF
    // Cx Group
    0x00, 0x00, 0x00, 0x1F, 0x10,  // C0
    0x10, 0x10, 0x10, 0x1F, 0x10,  // C1
    0x10, 0x10, 0x10, 0xF0, 0x10,  // C2
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    0x14, 0x14, 0x14, 0x17, 0x14,  // CF
    // Dx Group
    0x10, 0x10, 0x1F, 0x10, 0x1F,  // D0
    0x14, 0x14, 0x14, 0xF4, 0x14,  // D1
    0x10, 0x10, 0xF0, 0x10, 0xF0,  // D2
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    0x0F, 0x0F, 0x0F, 0x0F, 0x0F,  // DF
    // Ex Group
    0x38, 0x44, 0x44, 0x38, 0x44,  // E0
    0xFC, 0x4A, 0x4A, 0x4A, 0x34,  // E1
    0x7E, 0x02, 0x02, 0x06, 0x06,  // E2
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    0x7E, 0x01, 0x01, 0x01, 0x7E,  // EF
    // Fx Group
    0x2A, 0x2A, 0x2A, 0x2A, 0x2A,  // F0
    0x44, 0x44, 0x5F, 0x44, 0x44,  // F1
    0x40, 0x51, 0x4A, 0x44, 0x40,  // F2
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    0x00, 0x00, 0x00, 0x00, 0x00   // FF
#endif
};

#ifdef AP_NOTIFY_DISPLAY_USE_EMOJI
static_assert(ARRAY_SIZE(_font) == 1280, "_font is correct size");
#else
static_assert(ARRAY_SIZE(_font) == 475, "_font is correct size");
#endif

bool Display::init(void)
{
    // exit immediately if already initialised
    if (_driver != nullptr) {
        return true;
    }

    // initialise driver
    FOREACH_I2C(i) {
        switch (pNotify->_display_type) {
        case DISPLAY_SSD1306: {
            _driver = Display_SSD1306_I2C::probe(std::move(hal.i2c_mgr->get_device(i, NOTIFY_DISPLAY_I2C_ADDR)));
            break;
        }
        case DISPLAY_SH1106: {
            _driver = Display_SH1106_I2C::probe(std::move(hal.i2c_mgr->get_device(i, NOTIFY_DISPLAY_I2C_ADDR)));
            break;
        }
        case DISPLAY_SITL: {
#ifdef WITH_SITL_OSD
            _driver = Display_SITL::probe(); // never fails
#elif CONFIG_HAL_BOARD == HAL_BOARD_SITL
            ::fprintf(stderr, "SITL Display ineffective without --osd\n");
#endif
            break;
        }
        case DISPLAY_OFF:
        default:
            break;
        }
        if (_driver != nullptr) {
            break;
        }
    }

    if (_driver == nullptr) {
        return false;
    }

    // update all on display
    update_all();
    _driver->hw_update();

    return true;
}

void Display::update()
{
    // max update frequency 2Hz
    static uint8_t timer = 0;
    if (timer++ < 25) {
        return;
    }
    timer = 0;

    if (AP_Notify::flags.armed) {
        if (_screenpage != 1) {
            _driver->clear_screen();
            update_arm(3);
            _screenpage = 1;
            _driver->hw_update(); //update hw once , do not transmition to display in fly
        }
        return;
    }

    if (_screenpage != 2) {
        _driver->clear_screen(); //once clear screen when page changed
        _screenpage = 2;
    }

    update_all();
    _driver->hw_update(); //update at 2 Hz in disarmed mode

}

void Display::update_all()
{
    update_text(0);
    update_mode(1);
    update_battery(2);
    update_gps(3);
    //update_gps_sats(4);
    update_prearm(4);
    update_ekf(5);
}

void Display::draw_text(uint16_t x, uint16_t y, const char* c)
{
    if (nullptr == c) {
        return;
    }
    while (*c != 0) {
#ifndef AP_NOTIFY_DISPLAY_USE_EMOJI
        if (*c >= ' ' && *c <= '~') {
            draw_char(x, y, *c - ' ');
        } else {
            // convert oob characters to spaces
            draw_char(x, y, 0);
        }
#else
        draw_char(x, y, *c);
#endif
        x += 7;
        c++;
    }
}

void Display::draw_char(uint16_t x, uint16_t y, const char c)
{
    uint8_t line;

    // draw char to pixel
    for (uint8_t i = 0; i < 6; i++) {
        if (i == 5) {
            line = 0;
        } else {
            line = _font[(c * 5) + i];
        }

        for (uint8_t j = 0; j < 8; j++) {
            if (line & 1) {
                _driver->set_pixel(x + i, y + j);
            } else {
                _driver->clear_pixel(x + i, y + j);
            }
            line >>= 1;
        }
    }
}

void Display::update_arm(uint8_t r)
{
    if (AP_Notify::flags.armed) {
        draw_text(COLUMN(0), ROW(r), ">>>>> ARMED! <<<<<");
    } else {
        draw_text(COLUMN(0), ROW(r), "     disarmed     ");
    }
}

void Display::update_prearm(uint8_t r)
{
    if (AP_Notify::flags.pre_arm_check) {
        draw_text(COLUMN(0), ROW(r), "Prearm: passed    ");
    } else {
        draw_text(COLUMN(0), ROW(r), "Prearm: failed    ");
    }
}

void Display::update_gps(uint8_t r)
{
    static const char * gpsfixname[] = {"Other", "NoGPS","NoFix","2D","3D","DGPS", "RTK f", "RTK F"};
    char msg [DISPLAY_MESSAGE_SIZE];
    const char * fixname;
    switch  (AP_Notify::flags.gps_status) {
        case AP_GPS::NO_GPS:
            fixname = gpsfixname[1];
            break;
        case AP_GPS::NO_FIX:
            fixname = gpsfixname[2];
            break;
        case AP_GPS::GPS_OK_FIX_2D:
            fixname = gpsfixname[3];
            break;
        case AP_GPS::GPS_OK_FIX_3D:
            fixname = gpsfixname[4];
            break;
        case AP_GPS::GPS_OK_FIX_3D_DGPS:
            fixname = gpsfixname[5];
            break;
        case AP_GPS::GPS_OK_FIX_3D_RTK_FLOAT:
            fixname = gpsfixname[6];
            break;
        case AP_GPS::GPS_OK_FIX_3D_RTK_FIXED:
            fixname = gpsfixname[7];
            break;
        default:
            fixname = gpsfixname[0];
            break;
    }
    snprintf(msg, DISPLAY_MESSAGE_SIZE, "GPS:%-5s Sats:%2u", fixname, (unsigned)AP_Notify::flags.gps_num_sats) ;
    draw_text(COLUMN(0), ROW(r), msg);
}

void Display::update_gps_sats(uint8_t r)
{
    draw_text(COLUMN(0), ROW(r), "Sats:");
    draw_char(COLUMN(8), ROW(r), (AP_Notify::flags.gps_num_sats / 10) + '0');
    draw_char(COLUMN(9), ROW(r), (AP_Notify::flags.gps_num_sats % 10) + '0');
}

void Display::update_ekf(uint8_t r)
{
    if (AP_Notify::flags.ekf_bad) {
        draw_text(COLUMN(0), ROW(r), "EKF:    fail");
    } else {
        draw_text(COLUMN(0), ROW(r), "EKF:    ok  ");
    }
}

void Display::update_battery(uint8_t r)
{
    char msg [DISPLAY_MESSAGE_SIZE];
    snprintf(msg, DISPLAY_MESSAGE_SIZE, "BAT1: %4.2fV", (double)AP::battery().voltage()) ;
    draw_text(COLUMN(0), ROW(r), msg);
 }

void Display::update_mode(uint8_t r)
{
    char msg [DISPLAY_MESSAGE_SIZE];
    if (pNotify->get_flight_mode_str()) {
        snprintf(msg, DISPLAY_MESSAGE_SIZE, "Mode: %s", pNotify->get_flight_mode_str()) ;
        draw_text(COLUMN(0), ROW(r), msg);
    }
}

void Display::update_text_empty(uint8_t r)
{
    char msg [DISPLAY_MESSAGE_SIZE] = {};
    memset(msg, ' ', sizeof(msg)-1);
    _movedelay = 0;
    _mstartpos = 0;
    draw_text(COLUMN(0), ROW(r), msg);
}

void Display::update_text(uint8_t r)
{
    char msg [DISPLAY_MESSAGE_SIZE] = {};
    char txt [NOTIFY_TEXT_BUFFER_SIZE] = {};

    const bool text_is_valid = AP_HAL::millis() - pNotify->_send_text_updated_millis < _send_text_valid_millis;
    if (!text_is_valid) {
        update_text_empty(r);
        return;
    }

    if (_movedelay > 0) {
        _movedelay--;
        return;
    }

    snprintf(txt, sizeof(txt), "%s", pNotify->get_text());

    memset(msg, ' ', sizeof(msg)-1); // leave null termination
    const uint8_t len = strlen(&txt[_mstartpos]);
    const uint8_t to_copy = (len < sizeof(msg)-1) ? len : (sizeof(msg)-1);
    memcpy(msg, &txt[_mstartpos], to_copy);

    if (len <= sizeof(msg)-1) {
        // end-of-message reached; pause scrolling a while
        _movedelay = 4;
        // reset startpos so we start scrolling from the start again:
        _mstartpos = 0;
    } else {
        _mstartpos++;
    }

    draw_text(COLUMN(0), ROW(0), msg);
 }
