/*
 * CubeOrangeZephyr application entry point.
 *
 * Initialises USB CDC ACM using the new experimental USB device stack
 * (CONFIG_USB_DEVICE_STACK_NEXT).  Structure mirrors the Zephyr reference
 * sample at samples/subsys/usb/cdc_acm/, with the sample_usbd_init.c
 * helper inlined so we do not depend on the samples/ Kconfig tree.
 *
 * SPDX-License-Identifier: Apache-2.0
 */

#include <zephyr/device.h>
#include <zephyr/drivers/gpio.h>
#include <zephyr/drivers/uart.h>
#include <zephyr/kernel.h>
#include <zephyr/logging/log.h>
#include <errno.h>
#include <stdio.h>   /* fprintf/fflush below; not transitive under EXTERNAL_LIBC */

/*
  Generated by Tools/ardupilotwaf/zephyr_hwdef.py. Supplies the USB identity
  strings, including the "-BL" product suffix on bootloader builds, the same
  way chibios_hwdef.py emits HAL_USB_STRING_PRODUCT for AP_HAL_ChibiOS.
 */
#include "hwdef.h"

#if defined(CONFIG_USB_DEVICE_STACK_NEXT)
#include <zephyr/drivers/usb/udc.h>
#include <zephyr/usb/usbd.h>
#include <zephyr/usb/usb_ch9.h>
#endif

/* ardupilot_entry has C linkage — defined by AP_HAL_MAIN() in the vehicle
 * code or by ardupilot_stub.c during the first cmake pass. */
extern "C" int ardupilot_entry(int argc, char *const *argv);

#if defined(CONFIG_SOC_SERIES_STM32H7X)
#include <stm32_ll_bus.h>
#include <stm32_ll_rcc.h>
#include <stm32_ll_pwr.h>
#endif

LOG_MODULE_REGISTER(zeph_main, LOG_LEVEL_INF);

/* Diagnostic variables — readable from GDB.
 * g_usb_ret:           0=ok, <0=error, -999=never set, -998=before init
 * g_grstctl_post_reset: phase markers written during boot for tracing */
volatile int g_usb_ret = -999;
volatile int g_usb_init_ret = 0;  /* capture usbd_init() result */
volatile int g_usb_enable_ret = 0; /* capture usbd_enable() result */
volatile uint32_t g_grstctl_post_reset = 0xDEADBEEFU;  // "never written" sentinel
volatile uint32_t g_usb_phase = 0U;
/* UDC state captured after USB init; read over SWD (see main() for why these
 * are plain globals and not a hard-coded scratch address). */
volatile uint32_t g_udc_initialized = 0U;
volatile uint32_t g_udc_enabled = 0U;
volatile int g_usb_err_phase = 0;
volatile int g_usb_last_err = 0;
volatile uint32_t g_usb_last_msg = 0U;
volatile uint32_t g_snap_ahb1enr_before = 0U;
volatile uint32_t g_snap_d2ccip2r_before = 0U;
volatile uint32_t g_snap_pwr_cr3_before = 0U;
volatile uint32_t g_snap_gusbcfg_before = 0U;
volatile uint32_t g_snap_grstctl_before = 0U;
volatile uint32_t g_snap_ahb1enr_after = 0U;
volatile uint32_t g_snap_d2ccip2r_after = 0U;
volatile uint32_t g_snap_pwr_cr3_after = 0U;
volatile uint32_t g_snap_gusbcfg_after = 0U;
volatile uint32_t g_snap_grstctl_after = 0U;
volatile uint32_t g_snap_gotgctl_after = 0U;
volatile uint32_t g_snap_gotgint_after = 0U;
volatile uint32_t g_snap_dcfg_after = 0U;
volatile uint32_t g_snap_dctl_after = 0U;
volatile uint32_t g_snap_dsts_after = 0U;
volatile uint32_t g_snap_pcgcctl_after = 0U;

/* Live USB2 OTG register snapshots refreshed every heartbeat loop iteration.
 * These are readable from GDB SRAM even when D2 clock is gated during WFI. */
volatile uint32_t g_live_ahb1enr  = 0U;
volatile uint32_t g_live_gintmsk  = 0U;
volatile uint32_t g_live_gahbcfg  = 0U;
volatile uint32_t g_live_gintsts  = 0U;
volatile uint32_t g_live_gccfg    = 0U;
volatile uint32_t g_live_dctl     = 0U;
volatile uint32_t g_live_dsts     = 0U;
volatile uint32_t g_live_gotgctl  = 0U;
volatile uint32_t g_live_gusbcfg  = 0U;
volatile uint32_t g_live_dcfg     = 0U;
volatile uint32_t g_live_pcgcctl  = 0U;
volatile uint32_t g_live_heartbeat = 0U;

volatile uint32_t g_usb_d2ccip2r_before_clock_set = 0U;
volatile uint32_t g_usb_d2ccip2r_after_clock_set = 0U;
volatile uint32_t g_usb_clock_source_read = 0U;
static inline uint32_t read_reg32(const uintptr_t addr)
{
        return *((volatile uint32_t *)addr);
}

/* USB register debug snapshots (STM32H7 only, off by default). */
#define AP_ZEPHYR_USB_DEBUG_SNAPSHOTS 0

#if AP_ZEPHYR_USB_DEBUG_SNAPSHOTS
static void snapshot_usb_regs_before(void)
{
        g_snap_ahb1enr_before = read_reg32(0x580244D8U);
        g_snap_d2ccip2r_before = read_reg32(0x580244A8U);
        g_snap_pwr_cr3_before = read_reg32(0x5802480CU);
        g_snap_gusbcfg_before = read_reg32(0x4008000CU);
        g_snap_grstctl_before = read_reg32(0x40080010U);
}

static void snapshot_usb_regs_after(void)
{
        g_snap_ahb1enr_after = read_reg32(0x580244D8U);
        g_snap_d2ccip2r_after = read_reg32(0x580244A8U);
        g_snap_pwr_cr3_after = read_reg32(0x5802480CU);
        g_snap_gusbcfg_after = read_reg32(0x4008000CU);
        g_snap_grstctl_after = read_reg32(0x40080010U);
}

static void snapshot_usb_runtime_regs(void)
{
        g_snap_gotgctl_after = read_reg32(0x40080000U);
        g_snap_gotgint_after = read_reg32(0x40080004U);
        g_snap_dcfg_after = read_reg32(0x40080800U);
        g_snap_dctl_after = read_reg32(0x40080804U);
        g_snap_dsts_after = read_reg32(0x40080808U);
        g_snap_pcgcctl_after = read_reg32(0x40080E00U);
}
#endif

#if defined(CONFIG_SOC_SERIES_STM32H7X)
static void stm32h7_prime_usb_pwr(void)
{
        /* Prime VDDUSB/USBRDY path so UDC H7 power wait has valid state. */
        LL_PWR_EnableUSBVoltageDetector();
        LL_PWR_EnableUSBReg();
}

static void stm32h7_bootloader_style_usb_reinit(void)
{
        g_usb_phase = 151U;
        /* Zephyr's RCC init left D2CCIP2R at PLL1Q (240 MHz) and the bootloader's
         * AHB1ENR bit 27 was still set, so the OTG core took that pulse and wedged.
         * Hard-reset USB2 OTG via AHB1RSTR against the now-correct 48 MHz HSI48. */

        /* Disable ULPI clock (not used; we use the embedded FS PHY). */
        LL_AHB1_GRP1_DisableClock(LL_AHB1_GRP1_PERIPH_USB2OTGHSULPI);
        g_usb_phase = 152U;

        /* Quiesce: disable AHB1 clock for USB2 OTG before hardware reset. */
        LL_AHB1_GRP1_DisableClock(LL_AHB1_GRP1_PERIPH_USB2OTGHS);
        g_usb_phase = 153U;

        /* Issue hardware reset — clears all OTG core registers to power-on
         * defaults, removing any bad state from the 240 MHz PLL1Q transient. */
        LL_AHB1_GRP1_ForceReset(LL_AHB1_GRP1_PERIPH_USB2OTGHS);
        g_usb_phase = 154U;
        k_busy_wait(500U);  /* 500 µs — well above minimum reset pulse width */
        g_usb_phase = 155U;
        LL_AHB1_GRP1_ReleaseReset(LL_AHB1_GRP1_PERIPH_USB2OTGHS);
        g_usb_phase = 156U;
        for (volatile uint32_t i = 0U; i < 20000U; i++) {
                __NOP();
        }
        g_usb_phase = 157U;

        /* Re-enable AHB1 clock. OTG core now starts with D2CCIP2R = HSI48.
         * HAL_PCD_Init → USB_CoreInit will configure all registers and CSRST
         * should complete normally. No skip flags needed. */
        LL_AHB1_GRP1_EnableClock(LL_AHB1_GRP1_PERIPH_USB2OTGHS);
        g_usb_phase = 158U;

        g_usb_phase = 159U;
}

static void stm32h7_force_usb_clock_hsi48(void)
{
        /* CRITICAL: Force USB kernel clock to HSI48 (the bootloader had it there).
         * The Zephyr RCC initialization might leave it unset or at a bad value.
         * We use LL (low-level) functions to directly set USB clock selector.
         */
        LOG_INF("Configuring USB clock for HSI48");

        /* Capture D2CCIP2R before change */
        volatile uint32_t *d2ccip2r_reg = (volatile uint32_t *)0x580244A8U;
        g_usb_d2ccip2r_before_clock_set = *d2ccip2r_reg;

        /* Ensure HSI48 is enabled */
        if (!LL_RCC_HSI48_IsReady()) {
                LL_RCC_HSI48_Enable();
                /* Wait for HSI48 to be ready */
                uint32_t timeout = 1000;
                while (!LL_RCC_HSI48_IsReady() && timeout--) {
                        k_busy_wait(1);  /* 1 microsecond busy wait */
                }
                if (!LL_RCC_HSI48_IsReady()) {
                        LOG_WRN("HSI48 failed to stabilize");
                }
        }

        /* STM32H743 D2CCIP2R[21:20] USBSEL: 00b disabled, 01b PLL1Q, 10b PLL3Q,
         * 11b HSI48 - the correct value here.
         * LL_RCC_USB_CLKSOURCE_HSI48 = USBSEL_1|USBSEL_0 = 0x00300000. */
        LL_RCC_SetUSBClockSource(LL_RCC_USB_CLKSOURCE_HSI48);

        g_usb_d2ccip2r_after_clock_set = *d2ccip2r_reg;
        g_usb_clock_source_read = LL_RCC_GetUSBClockSource(0);
}
#endif

#if defined(CONFIG_USB_DEVICE_STACK_NEXT)
/* ── USB device context ────────────────────────────────────────────────────
 * Mirrors the USBD_DEVICE_DEFINE / USBD_DESC_* / USBD_CONFIGURATION_DEFINE
 * pattern from samples/subsys/usb/common/sample_usbd_init.c.
 */
USBD_DEVICE_DEFINE(cube_usbd,
                   DEVICE_DT_GET(DT_NODELABEL(zephyr_udc0)),
                   0x27B1U, 0x0004U);

USBD_DESC_LANG_DEFINE(cube_lang);
USBD_DESC_MANUFACTURER_DEFINE(cube_mfr, HAL_USB_STRING_MANUFACTURER);
USBD_DESC_PRODUCT_DEFINE(cube_product, HAL_USB_STRING_PRODUCT);
#if defined(CONFIG_HWINFO)
USBD_DESC_SERIAL_NUMBER_DEFINE(cube_sn);
#endif

USBD_DESC_CONFIG_DEFINE(fs_cfg_desc, "FS Configuration");
USBD_CONFIGURATION_DEFINE(cube_fs_config,
                           USB_SCD_SELF_POWERED,
                           125U, &fs_cfg_desc);

USBD_DESC_CONFIG_DEFINE(hs_cfg_desc, "HS Configuration");
USBD_CONFIGURATION_DEFINE(cube_hs_config,
                           USB_SCD_SELF_POWERED,
                           125U, &hs_cfg_desc);

/* Keep DFU detached unless explicitly requested in config. */
static const char *const class_blocklist[] = {
        "dfu_dfu",
        NULL,
};

K_SEM_DEFINE(dtr_sem, 0, 1);

K_SEM_DEFINE(usb_init_done_sem, 0, 1);
K_THREAD_STACK_DEFINE(usb_init_stack, 2048);

static struct k_thread usb_init_thread;
static volatile int g_usb_init_worker_ret = 0;

static void usb_init_worker(void *p1, void *p2, void *p3)
{
        struct usbd_context *ctx = (struct usbd_context *)p1;

        ARG_UNUSED(p2);
        ARG_UNUSED(p3);

#if defined(CONFIG_SOC_SERIES_STM32H7X)
        /* The ArduPilot bootloader enumerated this OTG core for DFU moments
         * before jumping to us and leaves it mid-session; USB_CoreReset()
         * (GRSTCTL.CSRST) never completes on the leftover state.  Pulse the
         * RCC block reset so the core starts from virgin hardware. */
        {
                volatile uint32_t *ahb1rstr = (volatile uint32_t *)0x58024480;
                *ahb1rstr |= (1U << 27);   /* USB2OTGRST (OTG_FS) */
                k_busy_wait(10);
                *ahb1rstr &= ~(1U << 27);
                k_busy_wait(100);
        }
#endif

        g_usb_init_worker_ret = usbd_init(ctx);
        k_sem_give(&usb_init_done_sem);
}

static int usbd_init_with_timeout(struct usbd_context *ctx, k_timeout_t timeout)
{
        k_tid_t tid;

        g_usb_init_worker_ret = -ETIMEDOUT;
        k_sem_reset(&usb_init_done_sem);

        tid = k_thread_create(&usb_init_thread,
                              usb_init_stack,
                              K_THREAD_STACK_SIZEOF(usb_init_stack),
                              usb_init_worker,
                              ctx, NULL, NULL,
                              K_PRIO_PREEMPT(8), 0, K_NO_WAIT);
        if (tid == NULL) {
                return -ENOMEM;
        }

        if (k_sem_take(&usb_init_done_sem, timeout) == 0) {
                return g_usb_init_worker_ret;
        }

        k_thread_abort(tid);
        return -ETIMEDOUT;
}

/* ── USB event callback ────────────────────────────────────────────────── */
static void usb_msg_cb(struct usbd_context *const ctx,
                       const struct usbd_msg *msg)
{
        g_usb_last_msg = (uint32_t)msg->type;
        LOG_INF("USBD message: %s", usbd_msg_type_string(msg->type));

        if (msg->type == USBD_MSG_CDC_ACM_CONTROL_LINE_STATE) {
                uint32_t dtr = 0U;

                (void)uart_line_ctrl_get(msg->dev, UART_LINE_CTRL_DTR, &dtr);
                if (dtr != 0U) {
                        k_sem_give(&dtr_sem);
                }
        }

        if (usbd_can_detect_vbus(ctx)) {
                if (msg->type == USBD_MSG_VBUS_READY) {
                        if (usbd_enable(ctx)) {
                                LOG_ERR("Failed to enable USB device support");
                        }
                }

                if (msg->type == USBD_MSG_VBUS_REMOVED) {
                        if (usbd_disable(ctx)) {
                                LOG_ERR("Failed to disable USB device support");
                        }
                }
        }
}

/* ── USB device bring-up ───────────────────────────────────────────────── */
static int enable_usb_device_next(void)
{
        int err;

        g_usb_phase = 10U;
        err = usbd_add_descriptor(&cube_usbd, &cube_lang);
        if (err) {
                g_usb_err_phase = 10;
                g_usb_last_err = err;
                LOG_ERR("Failed to add lang descriptor (%d)", err);
                return err;
        }

        g_usb_phase = 20U;
        err = usbd_add_descriptor(&cube_usbd, &cube_mfr);
        if (err) {
                g_usb_err_phase = 20;
                g_usb_last_err = err;
                LOG_ERR("Failed to add mfr descriptor (%d)", err);
                return err;
        }

        g_usb_phase = 30U;
        err = usbd_add_descriptor(&cube_usbd, &cube_product);
        if (err) {
                g_usb_err_phase = 30;
                g_usb_last_err = err;
                LOG_ERR("Failed to add product descriptor (%d)", err);
                return err;
        }

        /* RT1176 OTG1 is high-speed and the stack keeps a descriptor set per speed.
         * Registering only FS leaves no configuration for the speed it enumerates
         * at, so EP0 reads go unanswered: "device not accepting address". */
        g_usb_phase = 35U;
        if (USBD_SUPPORTS_HIGH_SPEED &&
            usbd_caps_speed(&cube_usbd) == USBD_SPEED_HS) {
                err = usbd_add_configuration(&cube_usbd, USBD_SPEED_HS, &cube_hs_config);
                if (err) {
                        g_usb_err_phase = 35;
                        g_usb_last_err = err;
                        LOG_ERR("Failed to add HS configuration (%d)", err);
                        return err;
                }

                g_usb_phase = 36U;
                err = usbd_register_all_classes(&cube_usbd, USBD_SPEED_HS, 1U, class_blocklist);
                if (err) {
                        g_usb_err_phase = 36;
                        g_usb_last_err = err;
                        LOG_ERR("Failed to register HS classes (%d)", err);
                        return err;
                }

                usbd_device_set_code_triple(&cube_usbd, USBD_SPEED_HS,
                                            USB_BCC_MISCELLANEOUS, 0x02U, 0x01U);
        }

        g_usb_phase = 40U;
        err = usbd_add_configuration(&cube_usbd, USBD_SPEED_FS, &cube_fs_config);
        if (err) {
                g_usb_err_phase = 40;
                g_usb_last_err = err;
                LOG_ERR("Failed to add FS configuration (%d)", err);
                return err;
        }

        /* Register all class instances (CDC ACM) for FS configuration 1 */
        g_usb_phase = 50U;
        err = usbd_register_all_classes(&cube_usbd, USBD_SPEED_FS, 1U, class_blocklist);
        if (err) {
                g_usb_err_phase = 50;
                g_usb_last_err = err;
                LOG_ERR("Failed to register classes (%d)", err);
                return err;
        }

        /* CDC ACM uses IAD — set composite device class triple accordingly */
        usbd_device_set_code_triple(&cube_usbd, USBD_SPEED_FS,
                                    USB_BCC_MISCELLANEOUS, 0x02U, 0x01U);
        usbd_self_powered(&cube_usbd, true);

#if defined(CONFIG_HWINFO)
        g_usb_phase = 60U;
        err = usbd_add_descriptor(&cube_usbd, &cube_sn);
        if (err) {
                g_usb_err_phase = 60;
                g_usb_last_err = err;
                LOG_ERR("Failed to add serial descriptor (%d)", err);
                return err;
        }
#endif

        g_usb_phase = 70U;
        err = usbd_msg_register_cb(&cube_usbd, usb_msg_cb);
        if (err) {
                g_usb_err_phase = 70;
                g_usb_last_err = err;
                LOG_ERR("Failed to register message callback (%d)", err);
                return err;
        }

        g_usb_phase = 80U;
#if AP_ZEPHYR_USB_DEBUG_SNAPSHOTS
        snapshot_usb_regs_before();
#endif
        int init_err = usbd_init_with_timeout(&cube_usbd, K_MSEC(30000));
        g_usb_init_ret = init_err;
#if AP_ZEPHYR_USB_DEBUG_SNAPSHOTS
        snapshot_usb_regs_after();
#endif
        if (init_err) {
                g_usb_err_phase = 80;
                g_usb_last_err = init_err;
                if (init_err == -ETIMEDOUT) {
                        g_usb_phase = 85U;
                        LOG_ERR("usbd_init() timed out; skipping usbd_enable() and continuing");
                        return init_err;
                }
                LOG_ERR("usbd_init() returned %d; attempting enable anyway", init_err);
        }

        /* Hardwire assumption: always assume USB is connected for testing.
         * Try to enable immediately, regardless of usbd_init() result.
         */
        g_usb_phase = 90U;
        g_usb_phase = 100U;
        int enable_err = usbd_enable(&cube_usbd);
        g_usb_enable_ret = enable_err;
#if AP_ZEPHYR_USB_DEBUG_SNAPSHOTS
        snapshot_usb_runtime_regs();
#endif
        if (enable_err) {
                g_usb_err_phase = 100;
                g_usb_last_err = enable_err;
                LOG_ERR("usbd_enable() returned %d", enable_err);
                return enable_err;
        }

#if defined(CONFIG_SOC_SERIES_STM32H7X)
        /* Debug bring-up: force clear soft-disconnect in case HAL leaves SDIS set. */
        volatile uint32_t *const dctl_reg = (volatile uint32_t *)0x40080804U;
        *dctl_reg &= ~0x00000002U;
#if AP_ZEPHYR_USB_DEBUG_SNAPSHOTS
        snapshot_usb_runtime_regs();
#endif
#endif /* CONFIG_SOC_SERIES_STM32H7X */

        /* If we reach here, enable succeeded */
        err = 0;

        g_usb_phase = 110U;
        g_usb_err_phase = 0;
        g_usb_last_err = 0;
        return 0;
}
#endif /* CONFIG_USB_DEVICE_STACK_NEXT */

/* ── LED heartbeat ─────────────────────────────────────────────────────── */
#define HEARTBEAT_PERIOD_MS 500

static const struct gpio_dt_spec led_amber =
        GPIO_DT_SPEC_GET_OR(DT_ALIAS(led_amber), gpios, {0});

struct serial_probe_chan {
        const struct device *dev;
        char marker;
};

static struct serial_probe_chan g_serial_probe[] = {
#if DT_NODE_HAS_STATUS(DT_ALIAS(serial1), okay)
        { DEVICE_DT_GET(DT_ALIAS(serial1)), '1' },
#endif
#if DT_NODE_HAS_STATUS(DT_ALIAS(serial2), okay)
        { DEVICE_DT_GET(DT_ALIAS(serial2)), '2' },
#endif
#if DT_NODE_HAS_STATUS(DT_ALIAS(serial3), okay)
        { DEVICE_DT_GET(DT_ALIAS(serial3)), '3' },
#endif
#if DT_NODE_HAS_STATUS(DT_ALIAS(serial4), okay)
        { DEVICE_DT_GET(DT_ALIAS(serial4)), '4' },
#endif
#if DT_NODE_HAS_STATUS(DT_ALIAS(serial5), okay)
        { DEVICE_DT_GET(DT_ALIAS(serial5)), '5' },
#endif
};

static void serial_probe_init(void)
{
        for (size_t i = 0; i < ARRAY_SIZE(g_serial_probe); i++) {
                if (!device_is_ready(g_serial_probe[i].dev)) {
                        LOG_WRN("serial%c device not ready", g_serial_probe[i].marker);
                }
        }
}

#if 0  // Serial probe emit not currently called
static void serial_probe_emit_once(void)
{
        for (size_t i = 0; i < ARRAY_SIZE(g_serial_probe); i++) {
                if (!device_is_ready(g_serial_probe[i].dev)) {
                        continue;
                }

                uart_poll_out(g_serial_probe[i].dev, g_serial_probe[i].marker);
                uart_poll_out(g_serial_probe[i].dev, '\r');
                uart_poll_out(g_serial_probe[i].dev, '\n');
        }
}
#endif

/* ── Entry point ───────────────────────────────────────────────────────── */

/* Zero the libc heap before ArduPilot runs: newlib malloc returns uninitialised
 * memory, so early objects start with heap garbage from previous boots and
 * fault. Zero from __bss_end to _heap_sentry, leaving ROM/WiFi vars above it. */
extern char __bss_end[];
extern char _heap_sentry[];
static void ap_extra_bss_zero(void)
{
#if defined(CONFIG_SOC_SERIES_ESP32S3)
        char *heap_start = __bss_end;       /* _end = 0x3fcd4b68 */
        char *heap_end   = _heap_sentry;    /* procpu_dram_end = 0x3fce9704 */
        if (heap_start < heap_end) {
                memset(heap_start, 0, (size_t)(heap_end - heap_start));
        }
#endif
}

int main(void)
{
        /* Earliest possible diagnostic — if this prints, app is running */
        printk("\n\n*** MAIN() STARTED ***\n");

        /* Force immediate output even if logging isn't set up yet */
        fprintf(stderr, "\n\n=== MAIN ENTERED ===\n");
        fflush(stderr);

        g_grstctl_post_reset = 0xAAAAAAAAU; /* marker: main() entered */
        g_usb_ret = -998;                   /* marker: before USB init */
        g_usb_phase = 1U;

        if (gpio_is_ready_dt(&led_amber)) {
                (void)gpio_pin_configure_dt(&led_amber, GPIO_OUTPUT_INACTIVE);
        }

        g_usb_phase = 2U;
#if defined(CONFIG_SOC_SERIES_STM32H7X)
        g_usb_phase = 11U;
        stm32h7_prime_usb_pwr();
        g_usb_phase = 12U;
        g_usb_phase = 13U;
        stm32h7_force_usb_clock_hsi48();
        g_usb_phase = 14U;
        g_usb_phase = 15U;
        stm32h7_bootloader_style_usb_reinit();
        g_usb_phase = 16U;
#endif
        g_usb_phase = 17U;
#if defined(CONFIG_USB_DEVICE_STACK_NEXT)
#if !defined(CONFIG_CDC_ACM_SERIAL_INITIALIZE_AT_BOOT)
        /* Manual USB init for boards (e.g. STM32) that don't use the
         * CDC_ACM_SERIAL_INITIALIZE_AT_BOOT auto-init path. */
        g_usb_ret = enable_usb_device_next();
#else
        /* CDC_ACM_SERIAL_INITIALIZE_AT_BOOT is set: Zephyr's cdc_acm_serial.c
         * already called usbd_init()+usbd_enable() at APPLICATION SYS_INIT
         * level before main() ran.  Nothing to do here. */
        g_usb_ret = 0;
#endif
        g_usb_phase = 3U;
        LOG_INF("%s: usbd=%d", CONFIG_BOARD, g_usb_ret);

        /* USB bring-up diagnostics, readable over SWD as ordinary globals. These
         * once wrote to a hard-coded 0x50000000, which does not exist on RT1176:
         * the imprecise bus fault surfaced at usbd_enable() and USB was blamed. */
        static const struct device *const udc_dev =
                DEVICE_DT_GET(DT_NODELABEL(zephyr_udc0));
        g_udc_initialized = (uint32_t)udc_is_initialized(udc_dev);
        g_udc_enabled = (uint32_t)udc_is_enabled(udc_dev);
#endif /* CONFIG_USB_DEVICE_STACK_NEXT */

        serial_probe_init();

        /* Zero any AP BSS that falls beyond Zephyr's __bss_end.
         * Must run before ardupilot_entry() initialises any C++ statics. */
        ap_extra_bss_zero();

        /* Hand off to ArduPilot.  ardupilot_entry() is defined by AP_HAL_MAIN()
         * in the vehicle/tool code (AP_MAIN == ardupilot_entry via zephyr.h).
         * The weak definition in ardupilot_stub.c lets cmake link an intermediate
         * zephyr.elf before the AP static library is available; it is overridden
         * at final link time by the real AP entry point. */
        return ardupilot_entry(0, NULL);
}

/* ardupilot_entry is defined in ardupilot_stub.c (first cmake pass, no AP lib)
 * or in the AP vehicle/tool archive (final link pass, ARDUPILOT_LIB set).
 * See CMakeLists.txt for the conditional source inclusion. */
