## libraries/AP_HAL_Zephyr/zephyr/boards/arm/cube_orange_zephyr/Kconfig.defconfig
```kconfig
if BOARD_CUBE_ORANGE_ZEPHYR

config BOARD
	default "cube_orange_zephyr"

endif # BOARD_CUBE_ORANGE_ZEPHYR
```

## libraries/AP_HAL_Zephyr/zephyr/boards/arm/cube_orange_zephyr/board.yml
```yaml
board:
  name: cube_orange_zephyr
  full_name: Hex CubeOrange (AP_HAL_Zephyr)
  vendor: hex
  socs:
    - name: stm32h743xx
```

## libraries/AP_HAL_Zephyr/zephyr/boards/arm/mr_vmu_rt1176/Kconfig.mr_vmu_rt1176
```kconfig
config BOARD_MR_VMU_RT1176
	select SOC_MIMXRT1176_CM7 if BOARD_MR_VMU_RT1176_MIMXRT1176_CM7
	select SOC_PART_NUMBER_MIMXRT1176DVMAA
	select BOARD_HAS_DCDC
```

## libraries/AP_HAL_Zephyr/zephyr/boards/arm/mr_vmu_rt1176/board.yml
```yaml
board:
  name: mr_vmu_rt1176
  full_name: NXP MR-VMU-RT1176
  vendor: nxp
  socs:
    - name: mimxrt1176
```

## libraries/AP_HAL_Zephyr/zephyr/boards/xtensa/esp32s3_zephyr/Kconfig.defconfig
```kconfig
# Copyright (c) 2024 ArduPilot Project
# SPDX-License-Identifier: Apache-2.0

config BOARD
	default "esp32s3_zephyr"
	depends on BOARD_ESP32S3_ZEPHYR
```

## libraries/AP_HAL_Zephyr/zephyr/boards/xtensa/esp32s3_zephyr/Kconfig.esp32s3_zephyr
```kconfig
# Copyright (c) 2024 ArduPilot Project
# SPDX-License-Identifier: Apache-2.0

config BOARD_ESP32S3_ZEPHYR
	select SOC_ESP32S3_WROOM_N8
	select SOC_ESP32S3_PROCPU
```

## libraries/AP_HAL_Zephyr/zephyr/boards/xtensa/esp32s3_zephyr/board.yml
```yaml
board:
  name: esp32s3_zephyr
  full_name: ESP32-S3 AP_HAL_Zephyr
  vendor: espressif
  socs:
    - name: esp32s3
```

## libraries/AP_HAL_Zephyr/zephyr/boards/xtensa/esp32s3_zephyr/esp32s3_zephyr_procpu_defconfig
```kconfig
# SPDX-License-Identifier: Apache-2.0
# ESP32-S3 AP_HAL_Zephyr board defconfig

CONFIG_CONSOLE=y
CONFIG_SERIAL=y
CONFIG_UART_CONSOLE=y
CONFIG_GPIO=y
CONFIG_CLOCK_CONTROL=y
CONFIG_PINCTRL=y
```
