/*
  Unit tests for the AES-256-XTS full-disk encryption engine (AP_DiskCrypto).

  Validated quantities:
    - the underlying AES-256 cipher against the FIPS-197 known-answer vector
    - a full 512-byte AES-256-XTS known-answer vector (reference: OpenSSL via
      python-cryptography), which pins the tweak derivation, byte ordering and
      GF(2^128) multiplication
    - round-trip correctness across many sectors and large LBAs
    - that the LBA tweak actually diffuses (identical plaintext at different
      LBAs yields different ciphertext, and ciphertext differs from plaintext)
 */

#include <AP_gtest.h>

#include <AP_DiskCrypto/AP_DiskCrypto.h>
#include <AP_DiskCrypto/tiny_aes.h>

#include <string.h>

const AP_HAL::HAL& hal = AP_HAL::get_HAL();

#if AP_DISKCRYPTO_ENABLED

// 64-byte XTS key used by the known-answer vector: bytes 0x00..0x3f
static void fill_kat_key(uint8_t key[AP_DISKCRYPTO_KEY_LEN])
{
    for (uint8_t i = 0; i < AP_DISKCRYPTO_KEY_LEN; i++) {
        key[i] = i;
    }
}

// plaintext used by the known-answer vector: pt[i] = (i*7 + 3) & 0xff
static void fill_kat_plaintext(uint8_t pt[AP_DiskCrypto::SECTOR_SIZE])
{
    for (uint16_t i = 0; i < AP_DiskCrypto::SECTOR_SIZE; i++) {
        pt[i] = uint8_t((i * 7 + 3) & 0xff);
    }
}

TEST(AP_DiskCrypto, AES256_FIPS197)
{
    // FIPS-197 appendix C.3 AES-256 single block
    const uint8_t key[32] = {
        0x00, 0x01, 0x02, 0x03, 0x04, 0x05, 0x06, 0x07,
        0x08, 0x09, 0x0a, 0x0b, 0x0c, 0x0d, 0x0e, 0x0f,
        0x10, 0x11, 0x12, 0x13, 0x14, 0x15, 0x16, 0x17,
        0x18, 0x19, 0x1a, 0x1b, 0x1c, 0x1d, 0x1e, 0x1f };
    const uint8_t pt[16] = {
        0x00, 0x11, 0x22, 0x33, 0x44, 0x55, 0x66, 0x77,
        0x88, 0x99, 0xaa, 0xbb, 0xcc, 0xdd, 0xee, 0xff };
    const uint8_t expected[16] = {
        0x8e, 0xa2, 0xb7, 0xca, 0x51, 0x67, 0x45, 0xbf,
        0xea, 0xfc, 0x49, 0x90, 0x4b, 0x49, 0x60, 0x89 };

    struct AES_ctx ctx;
    AES_init_ctx(&ctx, key);
    uint8_t buf[16];
    memcpy(buf, pt, sizeof(buf));
    AES_ECB_encrypt(&ctx, buf);
    EXPECT_EQ(0, memcmp(buf, expected, sizeof(buf)));
    AES_ECB_decrypt(&ctx, buf);
    EXPECT_EQ(0, memcmp(buf, pt, sizeof(buf)));
}

TEST(AP_DiskCrypto, XTS_KnownAnswer)
{
    // AES-256-XTS(key=0x00..0x3f, lba=0, pt[i]=(i*7+3)&0xff)
    // reference ciphertext produced with OpenSSL (python-cryptography).
    static const uint8_t expected[AP_DiskCrypto::SECTOR_SIZE] = {
        0x3f, 0x1f, 0x18, 0x7c, 0x64, 0xe5, 0xcc, 0x3f, 0x3e, 0xe9, 0x10, 0x69,
        0x21, 0x9b, 0x12, 0x38, 0xdc, 0x02, 0x3e, 0xbe, 0x9f, 0x4f, 0x3d, 0x4f,
        0x47, 0x5a, 0x5b, 0x10, 0x25, 0x82, 0xbd, 0x9d, 0x11, 0x09, 0xa4, 0x68,
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        0x96, 0xe8, 0xcd, 0x05, 0x54, 0x79, 0xc7, 0x57 };

    AP_DiskCrypto crypto;
    uint8_t key[AP_DISKCRYPTO_KEY_LEN];
    fill_kat_key(key);
    ASSERT_TRUE(crypto.init(key));

    uint8_t pt[AP_DiskCrypto::SECTOR_SIZE];
    fill_kat_plaintext(pt);

    uint8_t ct[AP_DiskCrypto::SECTOR_SIZE];
    ASSERT_TRUE(crypto.encrypt_sector(pt, ct, 0));
    EXPECT_EQ(0, memcmp(ct, expected, sizeof(ct)));

    // and decryption recovers the plaintext
    ASSERT_TRUE(crypto.decrypt_sector(ct, 0));
    EXPECT_EQ(0, memcmp(ct, pt, sizeof(ct)));
}

TEST(AP_DiskCrypto, RoundTripManySectors)
{
    AP_DiskCrypto crypto;
    uint8_t key[AP_DISKCRYPTO_KEY_LEN];
    for (uint8_t i = 0; i < AP_DISKCRYPTO_KEY_LEN; i++) {
        key[i] = uint8_t(0xA5 ^ (i * 3));
    }
    ASSERT_TRUE(crypto.init(key));

    const uint64_t lbas[] = { 0, 1, 63, 2048, 0x0001020304ULL, 0xFFFFFFFFFFFFFFFFULL };
    for (uint8_t k = 0; k < ARRAY_SIZE(lbas); k++) {
        uint8_t pt[AP_DiskCrypto::SECTOR_SIZE];
        for (uint16_t i = 0; i < sizeof(pt); i++) {
            pt[i] = uint8_t((i ^ (lbas[k] & 0xff)) + k);
        }
        uint8_t ct[AP_DiskCrypto::SECTOR_SIZE];
        ASSERT_TRUE(crypto.encrypt_sector(pt, ct, lbas[k]));
        EXPECT_NE(0, memcmp(ct, pt, sizeof(ct)));   // ciphertext must differ from plaintext
        ASSERT_TRUE(crypto.decrypt_sector(ct, lbas[k]));
        EXPECT_EQ(0, memcmp(ct, pt, sizeof(ct)));
    }
}

TEST(AP_DiskCrypto, TweakDependsOnLBA)
{
    AP_DiskCrypto crypto;
    uint8_t key[AP_DISKCRYPTO_KEY_LEN];
    fill_kat_key(key);
    ASSERT_TRUE(crypto.init(key));

    uint8_t pt[AP_DiskCrypto::SECTOR_SIZE];
    memset(pt, 0, sizeof(pt));

    uint8_t ct0[AP_DiskCrypto::SECTOR_SIZE];
    uint8_t ct1[AP_DiskCrypto::SECTOR_SIZE];
    ASSERT_TRUE(crypto.encrypt_sector(pt, ct0, 0));
    ASSERT_TRUE(crypto.encrypt_sector(pt, ct1, 1));
    // identical plaintext, adjacent LBAs => different ciphertext
    EXPECT_NE(0, memcmp(ct0, ct1, sizeof(ct0)));

    // decrypting with the wrong LBA must not recover the plaintext
    uint8_t wrong[AP_DiskCrypto::SECTOR_SIZE];
    memcpy(wrong, ct0, sizeof(wrong));
    ASSERT_TRUE(crypto.decrypt_sector(wrong, 1));
    EXPECT_NE(0, memcmp(wrong, pt, sizeof(wrong)));
}

TEST(AP_DiskCrypto, RejectsUninitialised)
{
    AP_DiskCrypto crypto;
    uint8_t pt[AP_DiskCrypto::SECTOR_SIZE] = {};
    uint8_t ct[AP_DiskCrypto::SECTOR_SIZE];
    EXPECT_FALSE(crypto.encrypt_sector(pt, ct, 0));
    EXPECT_FALSE(crypto.decrypt_sector(pt, 0));
}

TEST(AP_DiskCrypto, RejectsDuplicatedKey)
{
    // XTS requires the data key and tweak key (the two 32-byte halves) to
    // differ; init() must reject a key whose halves are identical and stay
    // uninitialised, matching the OpenSSL-based host recovery tool.
    AP_DiskCrypto crypto;
    uint8_t key[AP_DISKCRYPTO_KEY_LEN];
    for (uint8_t i = 0; i < AP_DISKCRYPTO_KEY_LEN; i++) {
        key[i] = uint8_t(i & 31);   // bytes 0..31 repeated => both halves equal
    }
    EXPECT_FALSE(crypto.init(key));
    EXPECT_FALSE(crypto.initialised());

    // and a key with distinct halves still initialises
    key[0] ^= 0xff;
    EXPECT_TRUE(crypto.init(key));
    EXPECT_TRUE(crypto.initialised());
}

#endif  // AP_DISKCRYPTO_ENABLED

AP_GTEST_MAIN()
