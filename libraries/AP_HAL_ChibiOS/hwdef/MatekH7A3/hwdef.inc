# hw definition file for processing by chibios_pins.py
# for Matek H7A3-slim

# MCU class and specific type
MCU STM32H7xx STM32H7A3xx

# crystal frequency, setup to use external oscillator
OSCILLATOR_HZ 16000000

FLASH_SIZE_KB 2048

# bootloader takes first 4 sectors
FLASH_RESERVE_START_KB 32

# ChibiOS system timer
STM32_ST_USE_TIMER 5
define CH_CFG_ST_RESOLUTION 32

define HAL_STORAGE_SIZE 15360

# use last 4 pages for flash storage
# H7A3 has 256 pages of 8k each
STORAGE_FLASH_PAGE 252

# use double page size for flash storage to effectively
# give 16k pages
define AP_FLASH_STORAGE_DOUBLE_PAGE 1
# # # # # # # # # # # # # # # # # # # # # # 


# USB
PA11 OTG_HS_DM OTG1
PA12 OTG_HS_DP OTG1

# Debug pins, PA14/PA13 are shared with the LEDs so that needs to be disabled
#PA13 JTMS-SWDIO SWD
#PA14 JTCK-SWCLK SWD

# SPI1 for ICM42688P & MAX7456
PA5 SPI1_SCK  SPI1
PA6 SPI1_MISO SPI1
PA7 SPI1_MOSI SPI1

# SPI2 for SD/NAND
PB10 SPI2_SCK  SPI2
PC2  SPI2_MISO SPI2
PC3  SPI2_MOSI SPI2

# CS pins
PC4 IMU_CS CS
PB2 MAX7456_CS CS
PC15 FLASH_CS CS
PC14 SD_CS CS

# ONE I2C bus
I2C_ORDER I2C3
PA8 I2C3_SCL I2C3
PC9 I2C3_SDA I2C3


# ADC
PC0 BATT_VOLTAGE_SENS ADC1 SCALE(1)
PC1 BATT_CURRENT_SENS ADC1 SCALE(1)
PA4 BATT2_VOLTAGE_SENS ADC1 SCALE(1)
PC5 BATT2_CURRENT_SENS ADC1 SCALE(1)

define HAL_BATT_MONITOR_DEFAULT 4
define HAL_BATT_VOLT_PIN 10
define HAL_BATT_CURR_PIN 11
define HAL_BATT2_VOLT_PIN 18
define HAL_BATT2_CURR_PIN 8
define HAL_BATT_VOLT_SCALE 21.0
define HAL_BATT_CURR_SCALE 40.0
define HAL_BATT2_VOLT_SCALE 21.0

# LED
# green LED1 marked as B/E
# blue LED0 marked as ACT
define AP_NOTIFY_GPIO_LED_2_ENABLED 1
PA14 LED0 OUTPUT LOW GPIO(90) # blue
PA13 LED1 OUTPUT LOW GPIO(91) # green
define HAL_GPIO_A_LED_PIN 91
define HAL_GPIO_B_LED_PIN 90


# --------------------- UARTs ---------------------------
SERIAL_ORDER OTG1  USART1 USART2 USART3 UART4 UART5 USART6

# USART1
PB14  USART1_TX USART1
PB15  USART1_RX USART1

# USART2 
PA2 USART2_TX USART2
PA3 USART2_RX USART2

# USART3
PC10 USART3_TX USART3
PC11 USART3_RX USART3

# UART4
PA0 UART4_TX UART4 NODMA
PA1 UART4_RX UART4 NODMA

# UART5
PC12 UART5_TX UART5 NODMA
PD2  UART5_RX UART5 NODMA

# USART6
PC6  USART6_TX USART6 NODMA
PC7  USART6_RX USART6 NODMA


# CAN bus
PB12 CAN2_RX CAN2
PB13 CAN2_TX CAN2

# PWM
PA9  TIM1_CH2  TIM1  PWM(1)  GPIO(50) BIDIR
PA10 TIM1_CH3  TIM1  PWM(2)  GPIO(51) BIDIR
PA15 TIM2_CH1  TIM2  PWM(3)  GPIO(52) BIDIR
PB3  TIM2_CH2  TIM2  PWM(4)  GPIO(53) 
PB0  TIM3_CH3  TIM3  PWM(5)  GPIO(54) BIDIR
PB1  TIM3_CH4  TIM3  PWM(6)  GPIO(55)
PB4  TIM3_CH1  TIM3  PWM(7)  GPIO(56)
PB5  TIM3_CH2  TIM3  PWM(8)  GPIO(57) BIDIR
PB6  TIM4_CH1  TIM4  PWM(9)  GPIO(58)
PB7  TIM4_CH2  TIM4  PWM(10) GPIO(59)
PB8  TIM16_CH1 TIM16 PWM(11) GPIO(60)

# Beeper
PB9  TIM17_CH1 TIM17 GPIO(32) ALARM

# GPIOs
PC13  PINIO1 OUTPUT GPIO(81) LOW
define RELAY1_PIN_DEFAULT 81

DMA_PRIORITY S*
DMA_NOSHARE SPI1* SPI2*


# ------------------- IMU ICM42688p ------------------
SPIDEV icm42688   SPI1 DEVID1 IMU_CS   MODE3  2*MHZ 16*MHZ

IMU Invensensev3  SPI:icm42688 ROTATION_NONE
define HAL_DEFAULT_INS_FAST_SAMPLE 1


# ------------------ OSD AT7456E ----------------------
SPIDEV osd       SPI1 DEVID4 MAX7456_CS   MODE0 10*MHZ 10*MHZ

define OSD_ENABLED 1
define HAL_OSD_TYPE_DEFAULT 1
ROMFS_WILDCARD libraries/AP_OSD/fonts/font*.bin


# ----------------- I2C compass & Baro -----------------
# no built-in compass, but probe the i2c bus for all possible
# external compass types
define ALLOW_ARM_NO_COMPASS
define AP_COMPASS_PROBING_ENABLED 1
define HAL_I2C_INTERNAL_MASK 0
define HAL_COMPASS_AUTO_ROT_DEFAULT 2

# built-in barometer
BARO SPL06  I2C:0:0x76
define AP_BARO_BACKEND_DEFAULT_ENABLED 0
define AP_BARO_SPL06_ENABLED 1
