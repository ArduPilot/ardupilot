# hw definition file for processing by chibios_hwdef.py
# for H757

# MCU class and specific type
MCU STM32H7xx STM32H757xx

define CORE_CM7
define SMPS_PWR

# setup build for a peripheral firmware
env AP_PERIPH 1

FLASH_SIZE_KB 2048


# the location where the bootloader will put the firmware
# the H743 has 128k sectors
FLASH_BOOTLOADER_LOAD_KB 256
FLASH_RESERVE_START_KB 256

# crystal frequency
OSCILLATOR_HZ 24000000

PB14 USART1_TX  USART1
PB15 USART1_RX  USART1

PA0 USART2_CTS USART2
PA1 USART2_RTS USART2
PA2 USART2_TX  USART2
PA3 USART2_RX  USART2

PD9 USART3_RX USART3 
PD8 USART3_TX USART3

SERIAL_ORDER OTG1 USART1 USART2 USART3

PA4 MCU_DCD OUTPUT LOW
PA5 MCU_DTR OUTPUT LOW
PA6 MCU_POW_ON OUTPUT HIGH
PA7 MCU_IO_2 OUTPUT LOW

# now we define the pins that USB is connected on
PA11 OTG_FS_DM OTG1
PA12 OTG_FS_DP OTG1

define USB_USE_WAIT TRUE
define HAL_USE_USB_MSD TRUE

PA13 JTMS-SWDIO SWD
PA14 JTCK-SWCLK SWD

PB3 LED_BOOTLOADER OUTPUT HIGH
PB4 LED OUTPUT HIGH
PB13 LED_2 OUTPUT HIGH

define HAL_LED_ON 0

# enable CAN support
PB8 CAN1_RX CAN1
PB9 CAN1_TX CAN1
PC7 SLEEPCAN OUTPUT PUSHPULL SPEED_LOW LOW 

# Now setup the pins for the microSD card, if available.
#PC8 SDMMC1_D0 SDMMC1
#PC9 SDMMC1_D1 SDMMC1
#PC10 SDMMC1_D2 SDMMC1
#PC11 SDMMC1_D3 SDMMC1
#PC12 SDMMC1_CK SDMMC1
#PD2 SDMMC1_CMD SDMMC1

define HAL_USE_EMPTY_STORAGE 1
define HAL_STORAGE_SIZE 16384

# analog input
define HAL_USE_ADC FALSE
define STM32_ADC_USE_ADC1 FALSE
define HAL_DISABLE_ADC_DRIVER TRUE

define HAL_GCS_ENABLED 0
