env SIM_ENABLED 1

define HAL_COMPASS_MAX_SENSORS 2

define HAL_NAVEKF2_AVAILABLE 0
define EK3_FEATURE_BODY_ODOM 0
define EK3_FEATURE_EXTERNAL_NAV 0
define EK3_FEATURE_DRAG_FUSION 0
define HAL_ADSB_ENABLED 0
define HAL_MOUNT_ENABLED 0
define HAL_PROXIMITY_ENABLED 0
define HAL_VISUALODOM_ENABLED 0
define HAL_GENERATOR_ENABLED 0
# define HAL_LOGGING_ENABLED 0
define HAL_CRSF_TELEM_ENABLED 0
#define OSD_ENABLED 0

define AP_MOTORS_FRAME_DEFAULT_ENABLED 0
define AP_MOTORS_FRAME_QUAD_ENABLED 1

define AP_LANDINGGEAR_ENABLED 0
define HAL_MSP_OPTICALFLOW_ENABLED 0
define HAL_SUPPORT_RCOUT_SERIAL 0
define HAL_HOTT_TELEM_ENABLED 0
# define HAL_GYROFFT_ENABLED 0

define AP_SIM_INS_FILE_ENABLED 0
