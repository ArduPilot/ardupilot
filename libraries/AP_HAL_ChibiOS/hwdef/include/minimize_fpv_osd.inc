# this is an include file for low-flash boards typically used in
# vehicles used for FPV/OSD flight.  These boards are unlikely to need
# drivers for rare sensors and power systems.

include minimize_common.inc

define AP_OPTICALFLOW_ENABLED 0

# minimize_common.py removes backends except for a select few.  Add
# some back in:
define AP_GPS_NMEA_ENABLED 1

define AP_MOTORS_FRAME_DEFAULT_ENABLED 0
define AP_MOTORS_FRAME_QUAD_ENABLED 1
define AP_MOTORS_FRAME_HEXA_ENABLED 1
define AP_MOTORS_FRAME_OCTA_ENABLED 1

define AP_SBUSOUTPUT_ENABLED 0

define AP_ICENGINE_ENABLED 0

define AP_ADVANCEDFAILSAFE_ENABLED 0

define AC_PRECLAND_ENABLED 0

# force Tramp support even in face of normal 1MB limit:
define AP_TRAMP_ENABLED AP_VIDEOTX_ENABLED && OSD_ENABLED

# force CRSF Telem text support even in face of normal 1MB limit:
define HAL_CRSF_TELEM_TEXT_SELECTION_ENABLED OSD_ENABLED && OSD_PARAM_ENABLED && HAL_CRSF_TELEM_ENABLED

# disable SMBUS battery monitors to save flash
undef AP_BATTERY_SMBUS_ENABLED
define AP_BATTERY_SMBUS_ENABLED 0

# remove most of the rangefinder drivers minimize_common.inc enables,
# leaving only the Benewake TF02, TF03, TFMINI and TFMINIPLUS:
undef AP_RANGEFINDER_ANALOG_ENABLED
undef AP_RANGEFINDER_BENEWAKE_CAN_ENABLED
undef AP_RANGEFINDER_BLPING_ENABLED
undef AP_RANGEFINDER_DRONECAN_ENABLED
undef AP_RANGEFINDER_GYUS42V2_ENABLED
undef AP_RANGEFINDER_HC_SR04_ENABLED
undef AP_RANGEFINDER_LANBAO_ENABLED
undef AP_RANGEFINDER_LEDDARONE_ENABLED
undef AP_RANGEFINDER_LEDDARVU8_ENABLED
undef AP_RANGEFINDER_LWI2C_ENABLED
undef AP_RANGEFINDER_LIGHTWARE_SERIAL_ENABLED
undef AP_RANGEFINDER_LUA_ENABLED
undef AP_RANGEFINDER_MAVLINK_ENABLED
undef AP_RANGEFINDER_MAXBOTIX_SERIAL_ENABLED
undef AP_RANGEFINDER_MAXSONARI2CXL_ENABLED
undef HAL_MSP_RANGEFINDER_ENABLED
undef AP_RANGEFINDER_NMEA_ENABLED
undef AP_RANGEFINDER_NRA24_CAN_ENABLED
undef AP_RANGEFINDER_PWM_ENABLED
undef AP_RANGEFINDER_PULSEDLIGHTLRF_ENABLED
undef AP_RANGEFINDER_TERARANGER_SERIAL_ENABLED
undef AP_RANGEFINDER_TOFSENSEP_CAN_ENABLED
undef AP_RANGEFINDER_TRI2C_ENABLED
undef AP_RANGEFINDER_USD1_CAN_ENABLED
undef AP_RANGEFINDER_USD1_SERIAL_ENABLED
undef AP_RANGEFINDER_VL53L0X_ENABLED
undef AP_RANGEFINDER_VL53L1X_ENABLED
undef AP_RANGEFINDER_WASP_ENABLED
undef AP_RANGEFINDER_HEXSOONRADAR_ENABLED
