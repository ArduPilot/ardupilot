# MCU class and specific type
MCU STM32H7xx STM32H743xx

# board ID for firmware load
APJ_BOARD_ID TARGET_HW_ARK_PI6X

# crystal frequency
OSCILLATOR_HZ 16000000

# flash size
FLASH_SIZE_KB 2048

# enable DFU reboot for installing bootloader
# note that if firmware is build with --secure-bl then DFU is
# disabled
ENABLE_DFU_BOOT 1

# USB
PA11 OTG_FS_DM OTG1
PA12 OTG_FS_DP OTG1
PA9 VBUS INPUT OPENDRAIN

# SWD
PA13 JTMS-SWDIO SWD
PA14 JTCK-SWCLK SWD

# Debug UART
PD8 USART3_TX USART3
PD9 USART3_RX USART3

# Telem1
PE8  UART7_TX  UART7
PF6  UART7_RX  UART7
PF8  UART7_RTS UART7
PE10 UART7_CTS UART7

# Telem2 (connected directly to Pi /dev/ttyAMA4)
PC8  UART5_RTS UART5
PC9  UART5_CTS UART5
PC12 UART5_TX  UART5
PD2  UART5_RX  UART5

# GPS1
PB6 USART1_TX USART1
PB7 USART1_RX USART1

# SD card
PD6  SDMMC2_CK SDMMC2
PD7  SDMMC2_CMD SDMMC2
PB14 SDMMC2_D0 SDMMC2
PB15 SDMMC2_D1 SDMMC2
PG11 SDMMC2_D2 SDMMC2
PB4  SDMMC2_D3 SDMMC2
define FATFS_HAL_DEVICE SDCD2

# armed indication
PE6 nARMED OUTPUT HIGH

# start peripheral power off
PG10 nVDD_5V_HIPOWER_EN OUTPUT HIGH
