env AP_PERIPH 1

define HAL_BUILD_AP_PERIPH 1
define PERIPH_FW 1
define HAL_RAM_RESERVE_START 0

define CANARD_ENABLE_CANFD 1
define CANARD_ENABLE_TAO_OPTION 1
define CANARD_MULTI_IFACE 1

# FIXME: SITL library should not be using AP_AHRS:
define AP_AHRS_ENABLED 1
define AP_AHRS_BACKEND_DEFAULT_ENABLED 0
define AP_AHRS_DCM_ENABLED 1  # need a default backend
define AP_EXTERNAL_AHRS_ENABLED 0

define HAL_MAVLINK_BINDINGS_ENABLED 1

define AP_AIRSPEED_AUTOCAL_ENABLE 0
define AP_CAN_SLCAN_ENABLED 0
define AP_ICENGINE_ENABLED 0
define AP_MISSION_ENABLED 0
define AP_RCPROTOCOL_ENABLED 0
define AP_RTC_ENABLED 0
define AP_SCHEDULER_ENABLED 0
define AP_SCRIPTING_ENABLED 0
define AP_STATS_ENABLED 0
define AP_UART_MONITOR_ENABLED 1
define COMPASS_CAL_ENABLED 0
define COMPASS_LEARN_ENABLED 0
define COMPASS_MOT_ENABLED 0
define HAL_CAN_DEFAULT_NODE_ID 0
define HAL_CANMANAGER_ENABLED 0
define HAL_GCS_ENABLED 0
define HAL_GENERATOR_ENABLED 0
define HAL_LOGGING_ENABLED 0
define HAL_LOGGING_MAVLINK_ENABLED 0
define HAL_PROXIMITY_ENABLED 0
define HAL_RALLY_ENABLED 0
define HAL_SUPPORT_RCOUT_SERIAL 0
define AP_TERRAIN_AVAILABLE 0
define AP_CUSTOMROTATIONS_ENABLED 0
define AP_PERIPH_BATTERY_ENABLED 0
define AP_PERIPH_DEVICE_TEMPERATURE_ENABLED 0
define AP_PERIPH_SERIAL_OPTIONS_ENABLED 0
define AP_PERIPH_ADSB_ENABLED 0
define AP_PERIPH_PROXIMITY_ENABLED 0
define AP_PERIPH_GPS_ENABLED 0
define AP_PERIPH_RELAY_ENABLED 0
define AP_PERIPH_IMU_ENABLED 0
define AP_PERIPH_MAG_ENABLED 0
define AP_PERIPH_BATTERY_BALANCE_ENABLED 0
define AP_PERIPH_BATTERY_TAG_ENABLED 0
define AP_PERIPH_BATTERY_BMS_ENABLED 0
define AP_PERIPH_MSP_ENABLED 0
define AP_PERIPH_BARO_ENABLED 0
define AP_PERIPH_EFI_ENABLED 0
define AP_PERIPH_RANGEFINDER_ENABLED 0
define AP_PERIPH_RC_OUT_ENABLED 0
define AP_PERIPH_RTC_ENABLED 0
define AP_PERIPH_RCIN_ENABLED 0
define AP_PERIPH_RPM_ENABLED 0
define AP_PERIPH_RPM_STREAM_ENABLED 0
define AP_PERIPH_AIRSPEED_ENABLED 0
define AP_PERIPH_HOBBYWING_ESC_ENABLED 0
define AP_PERIPH_NETWORKING_ENABLED 0
define AP_PERIPH_NOTIFY_ENABLED 0
define AP_PERIPH_PWM_HARDPOINT_ENABLED 0
define AP_PERIPH_ESC_APD_ENABLED 0
define AP_PERIPH_NCP5623_LED_WITHOUT_NOTIFY_ENABLED 0
define AP_PERIPH_NCP5623_BGR_LED_WITHOUT_NOTIFY_ENABLED 0
define AP_PERIPH_TOSHIBA_LED_WITHOUT_NOTIFY_ENABLED 0
define AP_PERIPH_BUZZER_ENABLED 0
define AP_PERIPH_BUZZER_WITHOUT_NOTIFY_ENABLED 0
define AP_PERIPH_RTC_GLOBALTIME_ENABLED 0
define AP_PERIPH_ACTUATOR_TELEM_ENABLED 0
