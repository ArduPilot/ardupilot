/*
  This program is free software: you can redistribute it and/or modify
  it under the terms of the GNU General Public License as published by
  the Free Software Foundation, either version 3 of the License, or
  (at your option) any later version.

  This program is distributed in the hope that it will be useful,
  but WITHOUT ANY WARRANTY; without even the implied warranty of
  MERCHANTABILITY or FITNESS FOR A PARTICULAR PURPOSE.  See the
  GNU General Public License for more details.

  You should have received a copy of the GNU General Public License
  along with this program.  If not, see <http://www.gnu.org/licenses/>.
*/
/*
  collection of CRCs. 
 */

#include <stdint.h>
#include "crc.h"

#include <AP_HAL/AP_HAL_Boards.h>

/**
 * crc4 method from datasheet for 16 bytes (8 short values)
 * 
 * @param [in] data
 * @return crc4 
 */
uint16_t crc_crc4(uint16_t *data)
{
    uint16_t n_rem = 0;
    uint8_t n_bit;

    for (uint8_t cnt = 0; cnt < 16; cnt++) {
        /* uneven bytes */
        if (cnt & 1) {
            n_rem ^= (uint8_t)((data[cnt >> 1]) & 0x00FF);
        } else {
            n_rem ^= (uint8_t)(data[cnt >> 1] >> 8);
        }

        for (n_bit = 8; n_bit > 0; n_bit--) {
            if (n_rem & 0x8000) {
                n_rem = (n_rem << 1) ^ 0x3000;
            } else {
                n_rem = (n_rem << 1);
            }
        }
    }

    return (n_rem >> 12) & 0xF;
}

static const uint8_t crc8_table[] = {
    0x00, 0x07, 0x0e, 0x09, 0x1c, 0x1b, 0x12, 0x15, 0x38, 0x3f, 0x36, 0x31,
    0x24, 0x23, 0x2a, 0x2d, 0x70, 0x77, 0x7e, 0x79, 0x6c, 0x6b, 0x62, 0x65,
    0x48, 0x4f, 0x46, 0x41, 0x54, 0x53, 0x5a, 0x5d, 0xe0, 0xe7, 0xee, 0xe9,
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    0xfa, 0xfd, 0xf4, 0xf3
};

/*
  crc8 from trone driver by Luis Rodrigues
 */
uint8_t crc_crc8(const uint8_t *p, uint8_t len)
{
	uint16_t crc = 0x0;

	while (len--) {
		const uint16_t i = (crc ^ *p++) & 0xFF;
		crc = (crc8_table[i] ^ (crc << 8)) & 0xFF;
	}

	return crc & 0xFF;
}

// CRC8 that does not use a lookup table: for generic polynomials
uint8_t crc8_generic(const uint8_t *buf, const uint16_t buf_len, const uint8_t polynomial)
{
    uint8_t crc = 0;
    for (uint16_t i = 0; i < buf_len; i++) {
        crc = crc8_dvb(buf[i], crc, polynomial);
    }
    return crc;
}

// crc8 from betaflight
uint8_t crc8_dvb_s2(uint8_t crc, uint8_t a)
{
    return crc8_dvb(crc, a, 0xD5);
}

// crc8 from betaflight
uint8_t crc8_dvb(uint8_t crc, uint8_t a, uint8_t seed)
{
    crc ^= a;
    for (uint8_t i = 0; i < 8; ++i) {
        if (crc & 0x80) {
            crc = (crc << 1) ^ seed;
        } else {
            crc = crc << 1;
        }
    }
    return crc;
}

// crc8 from betaflight
uint8_t crc8_dvb_s2_update(uint8_t crc, const void *data, uint32_t length)
{
    const uint8_t *p = (const uint8_t *)data;
    const uint8_t *pend = p + length;

    for (; p != pend; p++) {
        crc = crc8_dvb_s2(crc, *p);
    }
    return crc;
}

// copied from AP_FETtecOneWire.cpp
uint8_t crc8_dvb_update(uint8_t crc, const uint8_t* buf, const uint16_t buf_len)
{
    for (uint16_t i = 0; i < buf_len; i++) {
        crc = crc8_dvb(buf[i], crc, 0x7);
    }
    return crc;
}

/*
 CRC8-Maxim implementation based on FastCRC library
 see https://github.com/FrankBoesing/FastCRC
 */
static const uint8_t crc8_table_maxim[] = {
    0x00, 0x5e, 0xbc, 0xe2, 0x61, 0x3f, 0xdd, 0x83,
    0xc2, 0x9c, 0x7e, 0x20, 0xa3, 0xfd, 0x1f, 0x41,
    0x9d, 0xc3, 0x21, 0x7f, 0xfc, 0xa2, 0x40, 0x1e,
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    0xb6, 0xe8, 0x0a, 0x54, 0xd7, 0x89, 0x6b, 0x35
};

uint8_t crc8_maxim(const uint8_t *data, uint16_t length)
{
    uint16_t crc = 0x0;

    while (length--) {
        crc = crc8_table_maxim[crc ^ *data];
        data++;
    }

    return crc;
}

// CRC8-SAE J1850 (X8+X4+X3+X2+1) left move table
static const uint8_t crc8_table_sae[256] = {
    0x00, 0x1D, 0x3A, 0x27, 0x74, 0x69, 0x4E, 0x53, 0xE8, 0xF5, 0xD2, 0xCF, 0x9C, 0x81, 0xA6, 0xBB,
    0xCD, 0xD0, 0xF7, 0xEA, 0xB9, 0xA4, 0x83, 0x9E, 0x25, 0x38, 0x1F, 0x02, 0x51, 0x4C, 0x6B, 0x76,
    0x87, 0x9A, 0xBD, 0xA0, 0xF3, 0xEE, 0xC9, 0xD4, 0x6F, 0x72, 0x55, 0x48, 0x1B, 0x06, 0x21, 0x3C,
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    0x7F, 0x62, 0x45, 0x58, 0x0B, 0x16, 0x31, 0x2C, 0x97, 0x8A, 0xAD, 0xB0, 0xE3, 0xFE, 0xD9, 0xC4,
};

uint8_t crc8_sae(const uint8_t *data, uint16_t length)
{
    uint8_t crc = 0xFF;

    while (length--) {
        crc = crc8_table_sae[crc ^ (*data & 0xFF)];
        data++;
    }
    crc ^= 0xFF;

    return	crc;
}

/*
  xmodem CRC thanks to avr-liberty
  https://github.com/dreamiurg/avr-liberty
 */
uint16_t crc_xmodem_update(uint16_t crc, uint8_t data)
{
	crc = crc ^ ((uint16_t)data << 8);
	for (uint16_t i=0; i<8; i++)
	{
		if(crc & 0x8000) {
			crc = (crc << 1) ^ 0x1021;
		} else {
			crc <<= 1;
        }
	}

	return crc;
}

uint16_t crc_xmodem(const uint8_t *data, uint16_t len)
{
    uint16_t crc = 0;
    for (uint16_t i=0; i<len; i++) {
        crc = crc_xmodem_update(crc, data[i]);
    }
    return crc;
}

/*
  crc32 from Gary S Brown
 */
static const uint32_t crc32_tab[] = {
    0x00000000, 0x77073096, 0xee0e612c, 0x990951ba, 0x076dc419, 0x706af48f,
    0xe963a535, 0x9e6495a3, 0x0edb8832, 0x79dcb8a4, 0xe0d5e91e, 0x97d2d988,
    0x09b64c2b, 0x7eb17cbd, 0xe7b82d07, 0x90bf1d91, 0x1db71064, 0x6ab020f2,
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    0xb40bbe37, 0xc30c8ea1, 0x5a05df1b, 0x2d02ef8d
};


uint32_t crc_crc32(uint32_t crc, const uint8_t *buf, uint32_t size)
{
	for (uint32_t i=0; i<size; i++) {
		crc = crc32_tab[(crc ^ buf[i]) & 0xff] ^ (crc >> 8);
	}

	return crc;
}

// smaller (and slower) crc32 for bootloader
uint32_t crc32_small(uint32_t crc, const uint8_t *buf, uint32_t size)
{
    while (size--) {
        const uint8_t byte = *buf++;
        crc ^= byte;
        for (uint8_t i=0; i<8; i++) {
            const uint32_t mask = -(crc & 1);
            crc >>= 1;
            crc ^= (0xEDB88320 & mask);
        }
    }
    return crc;
}

/*
 * Copyright (C) 2010 Swift Navigation Inc.
 * Contact: Fergus Noble <fergus@swift-nav.com>
 *
 * This source is subject to the license found in the file 'LICENSE' which must
 * be be distributed together with this source. All other rights reserved.
 *
 * THIS CODE AND INFORMATION IS PROVIDED "AS IS" WITHOUT WARRANTY OF ANY KIND,
 * EITHER EXPRESSED OR IMPLIED, INCLUDING BUT NOT LIMITED TO THE IMPLIED
 * WARRANTIES OF MERCHANTABILITY AND/OR FITNESS FOR A PARTICULAR PURPOSE.
 */
/* CRC16 implementation according to CCITT standards */
static const uint16_t crc16tab[256] = {
  0x0000, 0x1021, 0x2042, 0x3063, 0x4084, 0x50A5, 0x60C6, 0x70E7,
  0x8108, 0x9129, 0xA14A, 0xB16B, 0xC18C, 0xD1AD, 0xE1CE, 0xF1EF,
  0x1231, 0x0210, 0x3273, 0x2252, 0x52B5, 0x4294, 0x72F7, 0x62D6,
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  0x6E17, 0x7E36, 0x4E55, 0x5E74, 0x2E93, 0x3EB2, 0x0ED1, 0x1EF0
};

uint16_t crc16_ccitt(const uint8_t *buf, uint32_t len, uint16_t crc)
{
    for (uint32_t i = 0; i < len; i++) {
        crc = (crc << 8) ^ crc16tab[((crc >> 8) ^ *buf++) & 0x00FF];
    }
    return crc;
}

// CRC16_CCITT algorithm using right shift
uint16_t crc16_ccitt_r(const uint8_t *buf, uint32_t len, uint16_t crc, uint16_t out)
{
	for (uint32_t i = 0; i < len; i++) {
		crc ^= *buf++;                      // XOR byte into least sig. byte of crc
		for (uint8_t j = 0; j < 8; j++) {   // loop over each bit
            if ((crc & 0x0001) != 0) {      // if the LSB is set
                crc >>= 1;                  // shift right and XOR 0x8408
                crc ^= 0x8408;
            } else {
                crc >>= 1;                  // just shift right
            }
		}
	}

    // output xor
    crc = crc ^ out;
	return crc;
}

uint16_t crc16_ccitt_GDL90(const uint8_t *buf, uint32_t len, uint16_t crc)
{
    for (uint32_t i = 0; i < len; i++) {
        crc = crc16tab[crc >> 8] ^ (crc << 8) ^ (uint16_t) *buf++;
    }
    return crc;
}

/**
 * Calculate Modbus CRC16 for array of bytes
 * 
 * @param [in] buf input buffer
 * @param [in] len size of buffer
 * @return CRC value
 */
uint16_t calc_crc_modbus(const uint8_t *buf, uint16_t len)
{
    uint16_t crc = 0xFFFF;
    for (uint16_t pos = 0; pos < len; pos++) {
        crc ^= (uint16_t) buf[pos]; // XOR byte into least sig. byte of crc
        for (uint8_t i = 8; i != 0; i--) { // Loop over each bit
            if ((crc & 0x0001) != 0) { // If the LSB is set
                crc >>= 1; // Shift right and XOR 0xA001
                crc ^= 0xA001;
            } else {
                // Else LSB is not set
                crc >>= 1; // Just shift right
            }
        }
    }
    return crc;
}

// fletcher 16 implementation
uint16_t crc_fletcher16(const uint8_t *buffer, uint32_t len) {
    uint16_t c0 = 0;
    uint16_t c1 = 0;
    for (uint32_t i = 0; i < len; i++) {
        c0 = (c0 + buffer[i]) % 255;
        c1 = (c1 + c0) % 255;
    }

    return (c1 << 8) | c0;
}

// FNV-1a implementation
#define FNV_1_PRIME_64 1099511628211UL
void hash_fnv_1a(uint32_t len, const uint8_t* buf, uint64_t* hash)
{
    uint32_t i;
    for (i=0; i<len; i++) {
        *hash ^= (uint64_t)buf[i];
        *hash *= FNV_1_PRIME_64;
    }
}

// calculate 24 bit crc. We take an approach that saves memory and flash at the cost of higher CPU load.
uint32_t crc_crc24(const uint8_t *bytes, uint16_t len)
{
    static constexpr uint32_t POLYCRC24 = 0x1864CFB;
    uint32_t crc = 0;
    while (len--) {
        uint8_t b = *bytes++;
        const uint8_t idx = (crc>>16) ^ b;
        uint32_t crct = idx<<16;
        for (uint8_t j=0; j<8; j++) {
            crct <<= 1;
            if (crct & 0x1000000) {
                crct ^= POLYCRC24;
            }
        }
        crc = ((crc<<8)&0xFFFFFF) ^ crct;
    }
    return crc;
}

// simple 8 bit checksum used by FPort
uint8_t crc_sum8_with_carry(const uint8_t *p, uint8_t len)
{
    uint16_t sum = 0;
    for (uint8_t i=0; i<len; i++) {
        sum += p[i];
        sum += sum >> 8;
        sum &= 0xFF;              
    }
    sum = 0xff - ((sum & 0xff) + (sum >> 8));
    return sum;
}

// CRC-16 (IBM/ANSI)
// Polynomial : x16 + x15 + x2 + 1 (polynomial representation : 0x8005)
// Initial Value : 0
uint16_t crc_crc16_ibm(uint16_t crc_accum, uint8_t *data_blk_ptr, uint16_t data_blk_size)
{
    uint16_t i;
    static const uint16_t crc_table[256] = {0x0000,
                                            0x8005, 0x800F, 0x000A, 0x801B, 0x001E, 0x0014, 0x8011,
                                            0x8033, 0x0036, 0x003C, 0x8039, 0x0028, 0x802D, 0x8027,
                                            0x0022, 0x8063, 0x0066, 0x006C, 0x8069, 0x0078, 0x807D,
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                                            0x820D, 0x8207, 0x0202 };

    for (uint16_t j = 0; j < data_blk_size; j++) {
        i = ((uint16_t)(crc_accum >> 8) ^ *data_blk_ptr++) & 0xFF;
        crc_accum = (crc_accum << 8) ^ crc_table[i];
    }

    return crc_accum;
}

/*
  64 bit crc matching px4 bootloader
*/
uint64_t crc_crc64(const uint32_t *data, uint16_t num_words)
{
    const uint64_t poly = 0x42F0E1EBA9EA3693ULL;
    uint64_t crc = ~(0ULL);
    while (num_words--) {
        uint32_t value = *data++;
        for (uint8_t j = 0; j < 4; j++) {
            uint8_t byte = ((uint8_t *)&value)[j];
            crc ^= (uint64_t)byte << 56u;
            for (uint8_t i = 0; i < 8; i++) {
                if (crc & (1ull << 63u)) {
                    crc = (uint64_t)(crc << 1u) ^ poly;
                } else {
                    crc = (uint64_t)(crc << 1u);
                }
            }
        }
    }
    crc ^= ~(0ULL);

    return crc;
}

// return the parity of byte - "1" if there is an odd number of bits
// set, "0" if there is an even number of bits set note that
// __builtin_parity causes hardfaults on Pixracer-periph - and is
// slower on 1 byte than this:
uint8_t parity(uint8_t byte)
{
    uint8_t p = 0;

    p ^= byte & 0x1;
    byte >>= 1;
    p ^= byte & 0x1;
    byte >>= 1;
    p ^= byte & 0x1;
    byte >>= 1;
    p ^= byte & 0x1;
    byte >>= 1;
    p ^= byte & 0x1;
    byte >>= 1;
    p ^= byte & 0x1;
    byte >>= 1;
    p ^= byte & 0x1;
    byte >>= 1;
    p ^= byte & 0x1;

    return p;
}

// sums the bytes in the supplied buffer, returns that sum mod 0xFFFF
uint16_t crc_sum_of_bytes_16(const uint8_t *data, uint16_t count)
{
    uint16_t ret = 0;
    for (uint32_t i=0; i<count; i++) {
        ret += data[i];
    }
    return ret;
}

// sums the bytes in the supplied buffer, returns that sum mod 256
// (i.e. shoved into a uint8_t)
uint8_t crc_sum_of_bytes(const uint8_t *data, uint16_t count)
{
    return crc_sum_of_bytes_16(data, count) & 0xFF;
}
